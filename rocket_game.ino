
// Scope Invaders!

const bool DEBUG = false;

const byte FIGURE_DELAY = 1; // trace delay in uS. adjust if needed
const int LOOP_DELAY = 1;

const int X_INPUT = A0; // Input pin for X controller
const int Y_INPUT = A1; // Input pin for Y controller
const int RESET_BUTTON = A2; // Input pin for reset button
const int DAC_SCALE = 2; // number of bits to right shift to convert from analogue input to DAC output (e.g. if analogue i/p is 10 bits and DAC o/pis 7 bits then set this to 3)

const int FRAME_TIME = 20;
const int SPLASH_TIME = 3000; // milliseconds to show splash screen

typedef struct button
{
  int pin;
  bool currentState;
  bool lastState; 
} ;

button buttons[] = { {RESET_BUTTON, LOW, LOW},};

typedef struct objectData
{
  int x;
  int y;
  bool active;
};

const byte NUM_LASERS = 10;
objectData laser[NUM_LASERS];

typedef struct enemyData
{
  int x;
  int y;
  bool active;
  byte width; 
  
};

const byte NUM_ENEMIES = 8;
enemyData enemies[NUM_ENEMIES];

int analogueX, analogueY;
bool currentState = LOW;
bool lastState = LOW;
unsigned long nextFrame = 0;

// Scope Invaders! splash
const int NUM_POINTS = 1100;
const byte x_points[NUM_POINTS] PROGMEM = {209,33,32,32,31,31,30,30,29,28,28,27,26,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218,218};
const byte y_points[NUM_POINTS] PROGMEM = {107,54,55,55,55,55,56,56,56,56,57,57,58,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105,105};

//Rocket

//const int NUM_POINTS_3 = 323;
//const byte x_points3[] PROGMEM = {24,24,22,22,24,26,25,23,21,21,23,25,27,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22,24};
//const byte y_points3[] PROGMEM = {0,1,1,2,2,2,3,3,3,4,4,4,4,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53,53};

//const int NUM_POINTS_3 = 646;
//const byte x_points3[] PROGMEM = {23,24,25,24,23,22,21,22,23,24,25,26,26,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23,24};
//const byte y_points3[] PROGMEM = {0,0,1,1,1,1,2,2,2,2,2,2,3,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53,53};

const int NUM_POINTS_3 = 646;
const byte x_points3[] PROGMEM = {23,24,24,23,22,22,21,21,22,22,21,21,21,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25,26};
const byte y_points3[] PROGMEM = {0,0,1,1,1,2,2,3,3,4,4,5,6,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1,2};


// Enemy
//const int NUM_POINTS_5 = 170;
//const byte x_points5[] PROGMEM = {27,26,25,24,23,22,21,20,19,18,17,16,15,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17,18};
//const byte y_points5[] PROGMEM = {7,7,7,7,7,7,7,7,7,7,7,7,7,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22,22};

const int NUM_POINTS_5 = 242;
const byte x_points5[] PROGMEM = {8,26,28,27,9,7,7,9,27,29,24,12,10,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13,11};
const byte y_points5[] PROGMEM = {0,0,0,1,1,1,2,2,2,2,3,3,4,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25,25};


//Laser
const int NUM_POINTS_4 = 8;
const byte x_points4[] PROGMEM = {0,0,0,0,0,0,0,0};
const byte y_points4[] PROGMEM = {0,1,2,3,4,5,6,7};

const byte numObjects = 3;
byte *objectX[numObjects] = {x_points3, x_points4, x_points5}; 
byte *objectY[numObjects] = {y_points3, y_points4, y_points5};
int objectNumPoints[numObjects] = {NUM_POINTS_3, NUM_POINTS_4, NUM_POINTS_5}; 
byte currentObject = 0;
int currentLaser = 0;

///////////
int Scale(int valToScale)
{
  return ((valToScale >> 1) - 256);
}
//////////////
bool DrawPoint(int x, int y)
{
  if ((x >= 0 && x < 256) && (y >= 0 && y < 256)) 
  {

    byte cbyte = byte((PORTC & B001111) | ((y & B00000011) << 4));
    byte bbyte = byte((y >> 2) & B00111111);

    PORTD = byte(x); // Port D is the 8 bits of x 
    PORTC = cbyte; // Map the 2 LSbs of y to port C pins 4-5
    PORTB = bbyte; // Map the 6 MSbs of y to Port B pins 0-5
    
    //delayMicroseconds(FIGURE_DELAY);
  }
}
////////
bool DrawObject(byte *xZero, byte *yZero, int xOffset, int yOffset, int numPoints, bool isProgMem)
{
    // Pass a pointer to the start of the array of points, plus the number of points. 
    // Assumes points are bytes but should probably generalise this.
  if(!DEBUG) 
  {
    if(isProgMem) // If points are stored in program memory rather than RAM
    {
      int x, y;
      for (int t=0; t < numPoints; t++) // run through points 
      { 
        x = (pgm_read_byte_near(xZero + t) + xOffset); 
        y = (pgm_read_byte_near(yZero + t) + yOffset); 
        DrawPoint(x,y);
      }

      return(true);
    }
    else
    {
      //Treat as normal array in RAM. (To Do)
      return(false);
    }
  }
}

bool ButtonPress(int i)
{
  bool isPressed = false;
  buttons[i].currentState = digitalRead(buttons[i].pin);
  if (buttons[i].currentState == HIGH && buttons[i].lastState == LOW) isPressed = true;
  buttons[i].lastState = buttons[i].currentState;
  return(isPressed);
}

void initialiseEnemies()
{
  for (byte i = 0; i < NUM_ENEMIES; i++)
  {
    enemies[i].x = (i % 4) * 64;
    enemies[i].y = (i / 4) * 32;
    enemies[i].active = true;
    enemies[i].width = 27;
  } 
}

///////////////////////////////////////////////////////////////////////////////////////////////
void setup(){
  
  Serial.end(); //Ensure the debug port is not active
  // initialize port D and B, and two pins on Port C for digital output
  DDRD = B11111111; 
  DDRB = DDRB | B00111111; // Keep the state of the top two pins (not sure if it matters)
  pinMode(A5, OUTPUT);
  pinMode(A4, OUTPUT);
  // Set up the pin for the reset button
  pinMode(RESET_BUTTON, INPUT);
  digitalWrite(RESET_BUTTON,LOW);
  randomSeed(analogRead(A3));
  

  for (byte i = 0; i < NUM_LASERS; i++)
  {
    laser[i].x = 0;
    laser[i].y = 0;
    laser[i].active = false;
  }

  initialiseEnemies();

  unsigned long startTime = 0;
  int max_points = 0;
  int x = 0; 
  int y = 0;

  //Draw the spash screen,bit by bit so it looks like it's beeing drawn by hand
  //Once drawn, show the picture for SPLASH_TIME
  while ((max_points < NUM_POINTS) || (millis() < startTime)) 
  {
    if(max_points < NUM_POINTS) 
    {
      max_points += 1;
      if (max_points >= NUM_POINTS - 2) startTime = millis() + SPLASH_TIME; 
    }
    for (int t=0; t < max_points; t++)// run through points
    { 
      x = (pgm_read_byte_near(x_points + t));
      y = (pgm_read_byte_near(y_points + t));
      DrawPoint(x,y);
    }
  }

  if(DEBUG) Serial.begin(9600); //Debug mode. Serial port can only be used if not outputting data to scope 

}
////////////////////////////////////////////////////////////////////////////////////////////////////////
void loop(){
  int y = 255;
  while (millis() < nextFrame) 
  {
    for (int x=0; x<256; x++) 
    {
      DrawPoint(x,y);
    } 


  }
  nextFrame = millis() + FRAME_TIME; // If it takes longer than a frame to complete a sequence, make sure nextFrame doesn't get left behind

  int x_offset = Scale(analogRead(X_INPUT));
  int y_offset = Scale(analogRead(Y_INPUT));
  
  //if(ButtonPress(0)) currentObject = (currentObject + 1) % numObjects; 
  if(ButtonPress(0)) 
  {
    laser[currentLaser].y = 0;
    laser[currentLaser].x = x_offset + 23;
    laser[currentLaser].active = true;
    currentLaser = (currentLaser + 1) % NUM_LASERS;
  }

  //Draw rocket
  DrawObject(objectX[currentObject], objectY[currentObject], x_offset, y_offset, objectNumPoints[currentObject], true);

  //DrawObject(objectX[4], objectY[4], enemies[0].x, enemies[0].y, objectNumPoints[4], true);

  for (byte i = 0; i < NUM_ENEMIES; i++)
  {
    if (enemies[i].active) 
    {
      DrawObject(objectX[2], objectY[2], enemies[i].x, enemies[i].y, objectNumPoints[2], true);
      enemies[i].y = (enemies[i].y + random(0,3)) % 256;
      enemies[i].x = enemies[i].x + random(-2,3);
      if (enemies[i].x < 0 || enemies[i].x > 254) 
      {
        enemies[i].x = random(23) * 10; 
        enemies[i].y = 0;    
      }
    }
  }

  //Draw lasers
  for (byte i = 0; i < NUM_LASERS; i++)
  {
    if (laser[i].active) 
    {
      DrawObject(objectX[1], objectY[1], laser[i].x, y_offset - laser[i].y, objectNumPoints[1], true);
      if (laser[i].y++ > 254) laser[i].active = false;
    }
  }

  //test for collision
  byte activeEnemies = 0;
  bool hit = false;
  for (byte i = 0; i < NUM_ENEMIES; i++)
  {
    if (enemies[i].active == true)
    {
      activeEnemies++;
      for (byte j = 0; j < NUM_LASERS; j++)
      {
        if (laser[j].active == true)
        {
          if ((laser[j].x > enemies[i].x) && (laser[j].x < (enemies[i].x + enemies[i].width)) && 
             (y_offset - laser[j].y > enemies[i].y) && (y_offset -laser[j].y < enemies[i].y + 20))
          {
             enemies[i].active = false;
             laser[j].active = false;
          }
        }
      }
      // collision with rocket detection to go here
      if ((enemies[i].y + 20 > y_offset) && (enemies[i].x + enemies[i].width > x_offset) && (enemies[i].x < x_offset + 48))
      {
        hit = true;
      }
         
    }
  }
  if (activeEnemies == 0 || hit == true) initialiseEnemies(); 
}
